&i2c1 {

	pinctrl-0 = <&i2c1_scl_pb8 &i2c1_sda_pb9>;
	pinctrl-names = "default";
	status = "okay";
	clock-frequency = <I2C_BITRATE_FAST>;
	
	ads1115@48{
	
		#io-channel-cells = <1>;
	
		compatible = "ti,ads1115";
		status = "okay";
		label = "ADS1115";
		reg = <0x48>;
		zephyr,gain = "ADC_GAIN_1";
		zephyr,reference = "ADC_REF_INTERNAL";
		zephyr,acquisition-time = <ADC_ACQ_TIME_DEFAULT>;	
	};
};

