## ADS1115_module/west.yml
```yaml
manifest:
  self:
    path: ADS1115_module

  remotes:
    - name: zephyrproject-rtos
      url-base: https://github.com/zephyrproject-rtos

  projects:
    - name: zephyr
      remote: zephyrproject-rtos
      revision: main
      import: true
```

## COILLINKMEM-MAIN/drivers/Kconfig
```kconfig
# drivers configuration options

# Copyright (c) 2020 Rubus Technologies Inc.
# SPDX-License-Identifier: Apache-2.0

menu "Device Drivers"

rsource "adc/Kconfig"
rsource "gpio/Kconfig"

endmenu
```

## COILLINKMEM-MAIN/drivers/adc/Kconfig
```kconfig
# ADC configuration options

# Copyright (c) 2021 Rubus Technologies Inc.
# SPDX-License-Identifier: Apache-2.0

#
# ADC options
#
menuconfig ADC
	bool "ADC drivers"
	# All platforms that implement the ADC driver are now required to
	# provide relevant DTS entries.
	help
	  Enable ADC (Analog to Digital Converter) driver configuration.

if ADC

rsource "Kconfig.ads1x1x"
rsource "Kconfig.ads1x4s0x"

endif # ADC
```

## COILLINKMEM-MAIN/drivers/adc/Kconfig.ads1x4s0x
```kconfig
# ADS1x4S0x ADC configuration options

# Copyright (c) 2021 Rubus Technologies Inc.
# SPDX-License-Identifier: Apache-2.0

config ADC_ADS1X4S0X
	bool "ADS1x4S0x driver"
	depends on SPI
	select ADC_CONFIGURABLE_INPUTS
	help
	  Enable ADS1x4S0x ADC driver.

	  The ADS1x4S0x is a multi-channel delta-sigma ADC with PGA and voltage
	  reference.

if ADC_ADS1X4S0X

config ADC_ADS1X4S0X_INIT_PRIORITY
	int "Init priority"
	default 80
	help
	  ADS1x4S0x ADC device driver initialization priority.

config ADC_ADS1X4S0X_ACQUISITION_THREAD_STACK_SIZE
	int "Stack size for the ADC data acquisition thread"
	default 400
	help
	  Size of the stack used for the internal data acquisition
	  thread.

config ADC_ADS1X4S0X_ACQUISITION_THREAD_PRIO
	int "Priority for the ADC data acquisition thread"
	default 0
	help
	  Priority level for the internal ADC data acquisition thread.

config ADC_ADS1X4S0X_CRC
	bool "Use Cyclic Redundancy Check (CRC)"
	default y
	help
	  Use Cyclic Redundancy Check (CRC) to verify the integrity of
	  the data read from the ADS1x4S0x.

config ADC_ADS1X4S0X_GPIO
	bool "Enable GPIO support"
	depends on GPIO
	select GPIO_ADS1X4S0X
	help
	  Enable GPIO child device support in the ADS1x4S0x ADC driver.

	  The GPIO functionality is handled by the ADS1x4S0x GPIO
	  driver.

endif # ADC_ADS1X4S0X
```

## COILLINKMEM-MAIN/drivers/gpio/Kconfig
```kconfig
# GPIO configuration options

# Copyright (c) 2021 Rubus Technologies Inc.
# SPDX-License-Identifier: Apache-2.0

menuconfig GPIO
	bool "GPIO Drivers"
	select HAS_DTS_GPIO
	help
	  Include GPIO drivers in system config

if GPIO

rsource "Kconfig.ads1x4s0x"

endif # GPIO
```

## COILLINKMEM-MAIN/drivers/gpio/Kconfig.ads1x4s0x
```kconfig
# ADS1x4S0x GPIO configuration options

# Copyright (c) 2021 Rubus Technologies Inc.
# SPDX-License-Identifier: Apache-2.0

menuconfig GPIO_ADS1X4S0X
	bool "ADS1x4S0x GPIO driver"
	depends on ADC_ADS1X4S0X_GPIO
	help
	  Enable GPIO driver for ADS1x4S0x.

	  The ADS1x4S0x is a multi-channel delta-sigma ADC with PGA and voltage
	  reference.

	  The GPIO port of the ADS1x4S0x (D0 to D3) is exposed as a
	  GPIO controller driver with read/write support.

config GPIO_ADS1X4S0X_INIT_PRIORITY
	int "Driver init priority"
	default 99
	depends on GPIO_ADS1X4S0X
	help
	  Device driver initialization priority. This driver must be
	  initialized after the ADS1x4S0x ADC driver.
```

## COILLINKMEM-MAIN/dts/bindings/adc/ti,ads1x4s0x.yaml
```yaml
# Copyright (c) 2021 Rubus Technologies Inc.
# SPDX-License-Identifier: Apache-2.0

description: |
  Low-Power, Low-Noise, Highly Integrated, 6- and 12-Channel,
  4-kSPS, 16/24-Bit, Delta-Sigma ADC with PGA and Voltage Reference
compatible: "ti,ads1x4s0x"

include: [adc-controller.yaml, spi-device.yaml]

bus: ads1x4s0x

properties:
    drdy-gpios:
      type: phandle-array
      required: false
      description: |
        The DRDY pin is an output that transitions low to indicate when
        conversion data are ready for retrieval.
    reset-gpios:
      type: phandle-array
      required: false
      description: |
        Reset the ADC by taking the RESET pin low.
    "#io-channel-cells":
      const: 2

io-channel-cells:
    - positive
    - negative
```

## COILLINKMEM-MAIN/dts/bindings/gpio/ti,ads1x4s0x-gpio.yaml
```yaml
description: TI ADS1X4S0X GPIO controller binding

compatible: "ti,ads1x4s0x-gpio"

include: [gpio-controller.yaml, base.yaml]

on-bus: ads1x4s0x

properties:
    label:
      required: true

    ngpios:
      required: true
      const: 4

    "#gpio-cells":
      const: 2

gpio-cells:
  - pin
  - flags
```

## DHT/sample.yaml
```yaml
#
# Copyright (c) 2019 Nordic Semiconductor ASA
#
# SPDX-License-Identifier: Apache-2.0
#

common:
  filter: TOOLCHAIN_HAS_NEWLIB == 1
sample:
  name: DHT Sensor Sample
tests:
  sample.sensor.dht:
    build_only: true
    platform_allow: nucleo_l496zg
    integration_platforms:
      - nucleo_l496zg
    tags: sensors
```

## build/Kconfig/Kconfig.modules
```kconfig
menu "canopennode (F:/PROJECT/CoilLink-Memory/modules/lib/canopennode)"
osource "$(ZEPHYR_CANOPENNODE_KCONFIG)"
config ZEPHYR_CANOPENNODE_MODULE
	bool
	default y
endmenu
menu "chre (F:/PROJECT/CoilLink-Memory/modules/lib/chre)"
osource "F:/PROJECT/CoilLink-Memory/modules/lib/chre/platform/zephyr/Kconfig"
config ZEPHYR_CHRE_MODULE
	bool
	default y
endmenu
menu "hal_gigadevice (F:/PROJECT/CoilLink-Memory/modules/hal/gigadevice)"
osource "$(ZEPHYR_HAL_GIGADEVICE_KCONFIG)"
config ZEPHYR_HAL_GIGADEVICE_MODULE
	bool
	default y
endmenu
menu "hal_infineon (F:/PROJECT/CoilLink-Memory/modules/hal/infineon)"
osource "$(ZEPHYR_HAL_INFINEON_KCONFIG)"
config ZEPHYR_HAL_INFINEON_MODULE
	bool
	default y
endmenu
menu "hal_nordic (F:/PROJECT/CoilLink-Memory/modules/hal/nordic)"
osource "$(ZEPHYR_HAL_NORDIC_KCONFIG)"
config ZEPHYR_HAL_NORDIC_MODULE
	bool
	default y
endmenu
menu "hal_nxp (F:/PROJECT/CoilLink-Memory/modules/hal/nxp)"
osource "$(ZEPHYR_HAL_NXP_KCONFIG)"
config ZEPHYR_HAL_NXP_MODULE
	bool
	default y
endmenu
menu "hal_rpi_pico (F:/PROJECT/CoilLink-Memory/modules/hal/rpi_pico)"
osource "$(ZEPHYR_HAL_RPI_PICO_KCONFIG)"
config ZEPHYR_HAL_RPI_PICO_MODULE
	bool
	default y
endmenu
menu "hal_telink (F:/PROJECT/CoilLink-Memory/modules/hal/telink)"
osource "F:/PROJECT/CoilLink-Memory/modules/hal/telink/Kconfig"
config ZEPHYR_HAL_TELINK_MODULE
	bool
	default y
endmenu
menu "liblc3codec (F:/PROJECT/CoilLink-Memory/modules/lib/liblc3codec)"
osource "$(ZEPHYR_LIBLC3CODEC_KCONFIG)"
config ZEPHYR_LIBLC3CODEC_MODULE
	bool
	default y
endmenu
menu "littlefs (F:/PROJECT/CoilLink-Memory/modules/fs/littlefs)"
osource "$(ZEPHYR_LITTLEFS_KCONFIG)"
config ZEPHYR_LITTLEFS_MODULE
	bool
	default y
endmenu
menu "loramac-node (F:/PROJECT/CoilLink-Memory/modules/lib/loramac-node)"
osource "$(ZEPHYR_LORAMAC_NODE_KCONFIG)"
config ZEPHYR_LORAMAC_NODE_MODULE
	bool
	default y
endmenu
menu "lvgl (F:/PROJECT/CoilLink-Memory/modules/lib/gui/lvgl)"
osource "F:/PROJECT/CoilLink-Memory/modules/lib/gui/lvgl/zephyr/Kconfig"
config ZEPHYR_LVGL_MODULE
	bool
	default y
endmenu
menu "lz4 (F:/PROJECT/CoilLink-Memory/modules/lib/lz4)"
osource "$(ZEPHYR_LZ4_KCONFIG)"
config ZEPHYR_LZ4_MODULE
	bool
	default y
endmenu
menu "mbedtls (F:/PROJECT/CoilLink-Memory/modules/crypto/mbedtls)"
osource "$(ZEPHYR_MBEDTLS_KCONFIG)"
config ZEPHYR_MBEDTLS_MODULE
	bool
	default y
endmenu
menu "nanopb (F:/PROJECT/CoilLink-Memory/modules/lib/nanopb)"
osource "$(ZEPHYR_NANOPB_KCONFIG)"
config ZEPHYR_NANOPB_MODULE
	bool
	default y
endmenu
menu "picolibc (F:/PROJECT/CoilLink-Memory/modules/lib/picolibc)"
osource "F:/PROJECT/CoilLink-Memory/modules/lib/picolibc/zephyr/Kconfig"
config ZEPHYR_PICOLIBC_MODULE
	bool
	default y
endmenu
menu "sof (F:/PROJECT/CoilLink-Memory/modules/audio/sof)"
osource "F:/PROJECT/CoilLink-Memory/modules/audio/sof/zephyr/Kconfig"
config ZEPHYR_SOF_MODULE
	bool
	default y
endmenu
menu "tflite-micro (F:/PROJECT/CoilLink-Memory/modules/lib/tflite-micro)"
osource "$(ZEPHYR_TFLITE_MICRO_KCONFIG)"
config ZEPHYR_TFLITE_MICRO_MODULE
	bool
	default y
endmenu
menu "TraceRecorder (F:/PROJECT/CoilLink-Memory/modules/debug/TraceRecorder)"
osource "F:/PROJECT/CoilLink-Memory/modules/debug/TraceRecorder/kernelports/Zephyr/Kconfig"
config ZEPHYR_TRACERECORDER_MODULE
	bool
	default y
endmenu
menu "trusted-firmware-m (F:/PROJECT/CoilLink-Memory/modules/tee/tf-m/trusted-firmware-m)"
osource "$(ZEPHYR_TRUSTED_FIRMWARE_M_KCONFIG)"
config ZEPHYR_TRUSTED_FIRMWARE_M_MODULE
	bool
	default y
endmenu
menu "zcbor (F:/PROJECT/CoilLink-Memory/modules/lib/zcbor)"
osource "$(ZEPHYR_ZCBOR_KCONFIG)"
config ZEPHYR_ZCBOR_MODULE
	bool
	default y
endmenu
menu "zscilib (F:/PROJECT/CoilLink-Memory/modules/lib/zscilib)"
osource "F:/PROJECT/CoilLink-Memory/modules/lib/zscilib/Kconfig.zscilib"
config ZEPHYR_ZSCILIB_MODULE
	bool
	default y
endmenu
```

## build/Kconfig/Kconfig.shield.defconfig
```kconfig
osource "F:/PROJECT/CoilLink-Memory/example-application/boards/shields/*/Kconfig.defconfig"
```
