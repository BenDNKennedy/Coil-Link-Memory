/*
 * Copyright (c) 2019 Nordic Semiconductor ASA
 *
 * SPDX-License-Identifier: Apache-2.0
 */

/ {
	#address-cells = <1>;

	soc{
		i2c1: i2c@40005400 {
			compatible = "st,stm32-i2c-v2";
			label = "I2C1";
			reg = < 0x40005400 0x400 >;

			ads1115@48{
				compatible = "ti,ads1115";
				status = "okay";
				label = "ADS1115";
				reg = <0x48>;
				zephyr, gain = ADC_GAIN_1;
				zephyr, reference = ADC_REF_INTERNAL;
				zephyr, acquisition-time = <ADC_ACQ_TIME_DEFAULT>;
			};
		};
	};
};

